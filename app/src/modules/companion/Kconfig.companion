## app/src/modules/companion/Kconfig.companion
```kconfig
# Copyright (c) 2026 Nordic Semiconductor ASA
# SPDX-License-Identifier: LicenseRef-Nordic-5-Clause

menuconfig APP_COMPANION
	bool "Companion UART from nRF54"
	default y
	depends on APP_NTN
	depends on SERIAL
	help
	  Receive person-detect thumbnails over UART and trigger NTN upload.

if APP_COMPANION

orsource "../../../../../common/Kconfig.companion"

config APP_COMPANION_THREAD_STACK_SIZE
	int "Companion thread stack size"
	default 6144
	help
	  Needs room for companion_frame_decode (thumb + header) plus logging/zbus.

config APP_COMPANION_THREAD_PRIORITY
	int "Companion thread priority"
	default 5
	help
	  Keep high enough to drain UART RX during thumbnail bursts from nRF54.

config APP_COMPANION_SHELL
	bool "Shell commands for local payload debug (att_companion)"
	default y
	depends on SHELL

config APP_COMPANION_NTN_UPLOAD
	bool "Upload received frames over NTN"
	default y
	help
	  Trigger an NTN upload for every complete frame from the nRF54.
	  Disable for UART-only bench tests without satellite coverage: frames
	  are still received, acknowledged and kept for att_companion dump/show,
	  and each new frame replaces the previous one.

module = APP_COMPANION
module-str = COMPANION
source "subsys/logging/Kconfig.template.log_config"

endif
```

## west.yml
```yaml
# Copyright (c) 2024 Nordic Semiconductor
# SPDX-License-Identifier: LicenseRef-Nordic-5-Clause

manifest:
  self:
    west-commands: scripts/west-commands.yml
    path: project

  remotes:
    - name: ncs
      url-base: https://github.com/nrfconnect
    - name: gide-remote
      url-base: https://github.com/DematteisGiacomo

  projects:
    - name: nrf
      remote:  gide-remote
      repo-path: sdk-nrf
      revision: 3653fec21b6a44d996217a37d3093ffe42b09160
      import: true
```
